/**
 * @cliArgs --board "/ti/boards/CC26X2R1_LAUNCHXL" --product "simplelink_cc13x2_26x2_sdk@5.20.00.52"
 * @versions {"data":"2021060817","timestamp":"2021060817","tool":"1.8.2+1992","templates":null}
 */

/**
 * Import the modules used in this configuration.
 */
const GPIO   = scripting.addModule("/ti/drivers/GPIO");
const GPIO1  = GPIO.addInstance();
const GPIO2  = GPIO.addInstance();
const GPIO3  = GPIO.addInstance();
const Power  = scripting.addModule("/ti/drivers/Power");
const RTOS   = scripting.addModule("/ti/drivers/RTOS");
const Timer  = scripting.addModule("/ti/drivers/Timer", {}, false);
const Timer1 = Timer.addInstance();
const UART2  = scripting.addModule("/ti/drivers/UART2", {}, false);
const UART21 = UART2.addInstance();
const RTOS_1 = scripting.addModule("/ti/utils/RTOS");

/**
 * Write custom configuration values to the imported modules.
 */
GPIO1.$hardware         = system.deviceData.board.components.LED_RED;
GPIO1.$name             = "CONFIG_GPIO_LED_0";
GPIO1.pinInstance.$name = "CONFIG_PIN_0";

GPIO2.$name             = "CONFIG_GPIO_LED_1";
GPIO2.$hardware         = system.deviceData.board.components.LED_GREEN;
GPIO2.pinInstance.$name = "CONFIG_PIN_1";

GPIO3.mode                    = "Dynamic";
GPIO3.$name                   = "CONFIG_GPIO_23";
GPIO3.gpioPin.$assign         = "boosterpack.2";
GPIO3.pinInstance.$name       = "CONFIG_PIN_2";
GPIO3.pinInstance.mode        = "Output";
GPIO3.pinInstance.outputState = "High";

Power.policyFunction = "PowerCC26XX_doWFI";

const CCFG              = scripting.addModule("/ti/devices/CCFG", {}, false);
CCFG.ccfgTemplate.$name = "ti_devices_CCFGTemplate0";

Timer1.$name                           = "CONFIG_TIMER_0";
Timer1.useGPTimer                      = true;
Timer1.timerType                       = "32 Bits";
Timer1.interruptPriority               = "1";
Timer1.timerInstance.$name             = "CONFIG_GPTIMER_1";
Timer1.timerInstance.interruptPriority = "1";
Timer1.timerInstance.timer.$assign     = "GPTM0";

UART21.$name               = "CONFIG_UART2_0";
UART21.$hardware           = system.deviceData.board.components.XDS110UART;
UART21.txPinInstance.$name = "CONFIG_PIN_3";
UART21.rxPinInstance.$name = "CONFIG_PIN_4";

/**
 * Pinmux solution for unlocked pins/peripherals. This ensures that minor changes to the automatic solver in a future
 * version of the tool will not impact the pinmux you originally saw.  These lines can be completely deleted in order to
 * re-solve from scratch.
 */
GPIO1.gpioPin.$suggestSolution     = "boosterpack.39";
GPIO2.gpioPin.$suggestSolution     = "boosterpack.40";
UART21.uart.$suggestSolution       = "UART0";
UART21.uart.txPin.$suggestSolution = "boosterpack.4";
UART21.uart.rxPin.$suggestSolution = "boosterpack.3";
